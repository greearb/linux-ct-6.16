## adtran-sdg-all.its
```
/dts-v1/;

/ {
	description = "U-Boot fitImage for adtran aarch64 kernel";
	#address-cells = <1>;

	images {
		kernel-1 {
			description = "Linux Kernel %version%";
			data = /incbin/("./arch/arm64/boot/Image.gz");
			type = "kernel";
			arch = "arm64";
			os = "linux";
			compression = "gzip";
			load = <0x44000000>;
			entry = <0x44000000>;
			hash-1 {
				algo = "sha1";
			};
		};
		fdt@SDG-8733v {
			description = "Flattened Device Tree blob";
			data = /incbin/("./arch/arm64/boot/dts/mediatek/mt7988a-smartrg-SDG-8733v.dtb");
			type = "flat_dt";
			arch = "arm64";
			load = <0x43500000>;
			compression = "none";
			hash-1 {
				algo = "sha1";
			};
		};
		fdt@SDG-8734v {
			description = "Flattened Device Tree blob";
			data = /incbin/("./arch/arm64/boot/dts/mediatek/mt7988a-smartrg-SDG-8734v.dtb");
			type = "flat_dt";
			arch = "arm64";
			load = <0x43500000>;
			compression = "none";
			hash-1 {
				algo = "sha1";
			};
		};
	};
	configurations {
		default = "conf@431";
		conf@431 {
			description = "Boot Linux kernel with adtran SDG-8733v FDT blob";
			kernel = "kernel-1";
			fdt = "fdt@SDG-8733v";
			hash-1 {
				algo = "sha1";
			};
		};
		conf@433 {
			description = "Boot Linux kernel with adtran SDG-8734v FDT blob";
			kernel = "kernel-1";
			fdt = "fdt@SDG-8734v";
			hash-1 {
				algo = "sha1";
			};
		};
	};
};
```

## adtran.its
```
/dts-v1/;

/ {
	description = "U-Boot fitImage for adtran aarch64 kernel";
	#address-cells = <1>;

	images {
		kernel-1 {
			description = "Linux Kernel %version%";
			data = /incbin/("./arch/arm64/boot/Image.gz");
			type = "kernel";
			arch = "arm64";
			os = "linux";
			compression = "gzip";
			load = <0x44000000>;
			entry = <0x44000000>;
			hash-1 {
				algo = "sha1";
			};
		};
		fdt-base {
			description = "Flattened Device Tree blob";
			data = /incbin/("./arch/arm64/boot/dts/mediatek/mt7988a-smartrg-SDG-8734v.dtb");
			type = "flat_dt";
			arch = "arm64";
			load = <0x43500000>;
			compression = "none";
			hash-1 {
				algo = "sha1";
			};
		};
	};
	configurations {
		default = "conf-sd";
		conf-sd {
			description = "Boot Linux kernel with adtran FDT blob";
			kernel = "kernel-1";
			fdt = "fdt-base";
			hash-1 {
				algo = "sha1";
			};
		};
	};
};
```
